## app/boards/shields/sidekick/Kconfig.shield
```kconfig
# Copyright (c) 2020 The ZMK Contributors
# SPDX-License-Identifier: MIT

config SHIELD_SIDEKICK
	def_bool $(shields_list_contains,sidekick)
```
